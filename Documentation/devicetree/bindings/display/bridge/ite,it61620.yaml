## Documentation/devicetree/bindings/display/bridge/ite,it61620.yaml
```yaml
# SPDX-License-Identifier: (GPL-2.0-only OR BSD-2-Clause)
%YAML 1.2
---
$id: http://devicetree.org/schemas/display/bridge/ite,it61620.yaml#
$schema: http://devicetree.org/meta-schemas/core.yaml#

title: ITE IT61620 MIPI DSI to HDMI Bridge

maintainers:
  - Pet Weng <pet.weng@ite.com.tw>

description: |
  The ITE IT61620 is a high-performance, low-power HDMI bridge that converts
  MIPI DSI input to HDMI 1.4b TMDS output. It supports up to 4 lanes of MIPI
  D-PHY 2.0 input at 2.5Gbps per lane (10Gbps total), compatible with DSI-2 v2.0.

  The HDMI transmitter side supports up to 4Kx2K@30Hz resolutions, and is
  compliant with HDMI 1.4b and HDCP 1.4.

  For audio, the IT61620 supports up to 8-channel LPCM via I2S (multi-line or
  TDM mode), with optional S/PDIF or DSD (for SACD). It supports audio
  sampling rates up to 192kHz.

allOf:
  - $ref: /schemas/sound/dai-common.yaml#

properties:
  compatible:
    const: ite,it61620

  reg:
    maxItems: 1

  interrupts-extended:
    maxItems: 1
    description: interrupt specifier of INT pin

  reset-gpios:
    maxItems: 1
    description: gpio specifier of RESET pin

  ivdd-supply:
    description: core voltage

  ovdd-supply:
    description: I/O voltage

  ovdd1833-supply:
    description: flexible I/O votage

  pinctrl-names:
    items:
      - const: default

  pinctrl-0:
    maxItems: 1

  "#sound-dai-cells":
    const: 0

  dsi-lanes:
    $ref: /schemas/types.yaml#/definitions/uint32
    description: Number of DSI input lanes used (1, 2 or 4)
    minimum: 1
    maximum: 4
    default: 4

  ports:
    $ref: /schemas/graph.yaml#/properties/ports

    properties:
      port@0:
        $ref: /schemas/graph.yaml#/$defs/port-base
        description: A port node pointing to DSI host port node

      port@1:
        $ref: /schemas/graph.yaml#/$defs/port-base
        description: Video port for HDMI output

    required:
      - port@0
      - port@1

required:
  - compatible
  - reg
  - interrupts-extended
  - reset-gpios
  - ivdd-supply
  - ovdd-supply
  - ovdd1833-supply
  - ports

unevaluatedProperties: false

examples:
  - |
    #include <dt-bindings/gpio/gpio.h>
    #include <dt-bindings/interrupt-controller/irq.h>

    i2c {
        #address-cells = <1>;
        #size-cells = <0>;

        hdmibrdg: ite61620@58 {
                compatible = "ite,it61620";
                reg = <0x58>;
                #sound-dai-cells = <0>;
                interrupts-extended = <&pio 128 IRQ_TYPE_LEVEL_LOW>;
                pinctrl-names = "default";
                pinctrl-0 = <&it61620_pins>;
                reset-gpios = <&pio 127 GPIO_ACTIVE_LOW>;
                ivdd-supply = <&pp1000_hdmi_x>;
                ovdd-supply = <&pp3300_vio28_x>;
                ovdd1833-supply = <&pp1800_vcamio_x>;
                dsi-lanes = <4>;
                status = "okay";

                ports {
                        #address-cells = <1>;
                        #size-cells = <0>;

                        port@0 {
                                reg = <0>;
                                it61620_dsi_in: endpoint {
                                        remote-endpoint = <&dsi_out>;
                                };
                        };

                        port@1 {
                                reg = <1>;
                                it61620_hdmi_out: endpoint {
                                        remote-endpoint = <&hdmi_connector_in>;
                                };
                        };
                };
        };
    };
```

## Documentation/devicetree/bindings/mailbox/mediatek,tinysys-mbox.yaml
```yaml
# SPDX-License-Identifier: (GPL-2.0-only OR BSD-2-Clause)
%YAML 1.2
---
$id: http://devicetree.org/schemas/mailbox/mediatek,tinysys-mbox.yaml#
$schema: http://devicetree.org/meta-schemas/core.yaml#

title: MediaTek TinySys mailbox controller

maintainers:
  - Hailong Fan <Hailong.Fan@mediatek.com>

description: |
  The MediaTek tinysys-mbox Inter-Processor Communication (IPC) enables the SoC
  to communicate with the Tiny System (tinysys) by passing messages through
  multiple mailbox channels. The MediaTek tinysys-mbox IPC also provides the
  ability for one processor to signal the other processor using interrupts.
  This mailbox controller is typically used as a communication mechanism
  between the main processor and tinysys subsystems, and is often managed
  under the SCMI (System Control and Management Interface) framework.

properties:
  compatible:
    - const: mediatek,tinysys_mbox

  "#mbox-cells":
    const: 1

  reg:
    minItems: 2
    maxItems: 2

  shmem:
    minItems: 2
    maxItems: 2
    description: |
      References to the shared memory regions used for SCMI message
      transmission (TX) and reception (RX).

  interrupts:
    minItems: 2
    maxItems: 2

required:
  - compatible
  - reg
  - shmem
  - interrupts
  - "#mbox-cells"

additionalProperties: false

examples:
  - |
    #include <dt-bindings/interrupt-controller/arm-gic.h>
    #include <dt-bindings/interrupt-controller/irq.h>

    soc {
        #address-cells = <2>;
        #size-cells = <2>;

        tinysys_mbox: tinysys-mbox@1c351000 {
            compatible = "mediatek,tinysys_mbox";
            reg = <0 0x1c351000 0 0x1000>,
                  <0 0x1c361000 0 0x1000>;
            shmem = <&scmi_tx_shmem>, <&scmi_rx_shmem>;
            interrupts = <0 509 4>,
                         <0 510 4>;
            #mbox-cells = <1>;
        };
    };
```
